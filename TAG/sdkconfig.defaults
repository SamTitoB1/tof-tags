## TAG/sdkconfig.defaults
```kconfig
# sdkconfig.defaults — ESP32-S3 FTM Tag (responder)

CONFIG_IDF_TARGET="esp32s3"

# FTM responder — this is the key setting for the tag
CONFIG_ESP_WIFI_FTM_RESPONDER_SUPPORT=y
# Tag does not initiate FTM
CONFIG_ESP_WIFI_FTM_INITIATOR_SUPPORT=n

# STA not needed — AP only
CONFIG_ESP_WIFI_SOFTAP_SUPPORT=y

# Logging
CONFIG_LOG_DEFAULT_LEVEL_INFO=y

# NVS
CONFIG_NVS_ENCRYPTION=n
```
